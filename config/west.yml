## config/west.yml
```yaml
manifest:
  remotes:
    - name: zmkfirmware
      url-base: https://github.com/zmkfirmware
    # Additional modules containing boards/shields/custom code can be listed here as well
    # See https://docs.zephyrproject.org/3.2.0/develop/west/manifest.html#projects
  projects:
    - name: zmk
      remote: zmkfirmware
      revision: ff09f2d  # Pinned to a main commit for Zephyr 4.1/HWMv2; switch to the v0.4 release tag once it's published
      import: app/west.yml
  self:
    path: config
```
